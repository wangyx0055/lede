## package/kernel/mt7628/config.in
```kconfig
if PACKAGE_kmod-mt7628
config MT_WIFI
	tristate "MT WIFI Driver"
	select WIFI_BASIC_FUNC if MT_WIFI
	select RALINK_MT7628
	select MT7628

config RALINK_MT7628
	bool
	default y
config MT7628
	bool
	default y
if MT_WIFI
menu "WiFi Generic Feature Options"
choice
		prompt "EEPROM Type of 1st Card"
		depends on ! FIRST_IF_NONE

		config FIRST_IF_EEPROM_FLASH
		bool "FLASH"
endchoice

config RT_FIRST_CARD_EEPROM
		string
		depends on ! FIRST_IF_NONE
		default "flash" if FIRST_IF_EEPROM_FLASH

choice
		prompt "EEPROM Type of 2nd Card"
		depends on ! SECOND_IF_NONE

		config SECOND_IF_EEPROM_PROM
		bool "EEPROM"

		config SECOND_IF_EEPROM_EFUSE
		bool "EFUSE"

		config SECOND_IF_EEPROM_FLASH
		bool "FLASH"
endchoice
config RT_FIRST_IF_RF_OFFSET
		string
		default "262144"
config RT_FIRST_CARD
		string
		default "7628"
config RT_SECOND_CARD_EEPROM
		string
		depends on ! SECOND_IF_NONE
		default "prom" if SECOND_IF_EEPROM_PROM
		default "efuse" if SECOND_IF_EEPROM_EFUSE
		default "flash" if SECOND_IF_EEPROM_FLASH
		
config MULTI_INF_SUPPORT
		bool
		default y if !FIRST_IF_NONE && !SECOND_IF_NONE
		
config WIFI_BASIC_FUNC
	bool "Basic Functions"
	select WIRELESS_EXT
	select WEXT_SPY
	select WEXT_PRIV
        
config MT7628_WSC_INCLUDED
	bool "WSC (WiFi Simple Config)"
	default y

config MT7628_WSC_V2_SUPPORT
	bool "WSC V2(WiFi Simple Config Version 2.0)"
	default y

config MT7628_DOT11W_PMF_SUPPORT
	bool "PMF"
	default y

config MT7628_LLTD_SUPPORT
	bool "LLTD (Link Layer Topology Discovery Protocol)"
	default n

config MT7628_QOS_DLS_SUPPORT
	bool "802.11e DLS ((Direct-Link Setup) Support"
	default n

#config MT7628_WAPI_SUPPORT
#	bool "WAPI Support"
#	depends on WIFI_DRIVER
#	default n

config MT7628_IGMP_SNOOP_SUPPORT
	bool "IGMP snooping"
	default n

config MT7628_BLOCK_NET_IF
	bool "NETIF Block"
	default n
	help
	Support Net interface block while Tx-Sw queue full

config MT7628_RATE_ADAPTION
	bool "New Rate Adaptation support"
	default y

config MT7628_NEW_RATE_ADAPT_SUPPORT
	bool "Intelligent Rate Adaption"
	depends on MT7628_RATE_ADAPTION
	default y

config MT7628_AGS_SUPPORT
	bool "Adaptive Group Switching"
	depends on  MT7628_RATE_ADAPTION
	default n
    
config MT7628_IDS_SUPPORT
	bool "IDS (Intrusion Detection System) Support"
	default n

config MT7628_WIFI_WORK_QUEUE
	bool "Work Queue"
	default n

config MT7628_WIFI_SKB_RECYCLE
	bool "SKB Recycle(Linux)"
	default n

config MT7628_SMART_CARRIER_SENSE_SUPPORT
        bool "Smart Carrier Sense"
        default y

config MT7628_LED_CONTROL_SUPPORT
	bool "LED Support"
	default n

config MT7628_ATE_SUPPORT
	bool "ATE/QA Support"
	default y

config MT7628_MEMORY_OPTIMIZATION
	bool "Memory Optimization"
	default n

config MT7628_PASSPOINT_R2
	bool "Passpoint Release-2 Support"
	select MT7628_DOT11W_PMF_SUPPORT
	default n

#config MT7628_TRACE_IPARP
#	bool "IP/ARP trace log"
#	depends on WIFI_DRIVER

config MT7628_SINGLE_SKU
	bool "Single SKU Support"
	default n

config MT7628_UAPSD
	bool "UAPSD support"
	default y
	
config MT7628_ELIAN
	bool "Smart Connection"
	depends on MT7628_APCLI_SUPPORT
	default n

#
# Section for chip architectures
#
# "MT MAC Support"
config MT_MAC
	bool
	default y

# "RLT MAC Support"
#config RLT_MAC
#	bool
#	depends on WIFI_DRIVER
#	default n

#config RLT_BBP
#	bool

#config RLT_RF
#	bool

# "RTMP MAC Support"
#config RTMP_MAC
#	bool
#	depends on WIFI_DRIVER
#	default n

#config RTMP_BBP
#    	bool

#config RTMP_RF
#    	bool

#
# Section for interfaces
#
config RTMP_PCI_SUPPORT
    	bool

config RTMP_USB_SUPPORT
		bool

config RTMP_RBUS_SUPPORT
    	bool

endmenu

menu "WiFi Operation Modes"
	choice
		prompt "Main Mode"
		default MT_WIFI_MODE_AP

		config MT_WIFI_MODE_AP
				bool "AP"
				select MT_AP_SUPPORT

		config MT_WIFI_MODE_STA
				bool "STA"
				select MT_STA_SUPPORT

		config MT_WIFI_MODE_BOTH
				bool "APSTA"
				select MT_AP_SUPPORT
				select MT_STA_SUPPORT

    endchoice

    if MT_WIFI_MODE_AP || MT_WIFI_MODE_BOTH
		source "package/kernel/mt7628/src/embedded/mt_wifi_ap/Kconfig"
    endif

    if WIFI_MODE_STA || WIFI_MODE_BOTH
		source "package/kernel/mt7628/src/embedded/mt_wifi_sta/Kconfig"
    endif

config MT_AP_SUPPORT
		bool

config MT_STA_SUPPORT
		bool

endmenu	

endif



endif
```

## package/kernel/rt_flash/src/Kconfig
```kconfig
config RT_FLASH
	tristate "Mediatek flash device"
	help
	  This is an Mediatek flash driver
```
